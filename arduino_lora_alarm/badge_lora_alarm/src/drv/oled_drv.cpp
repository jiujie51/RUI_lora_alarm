#include <stdint.h>
/*
 * OLED SSD1306 128x64 I2C 驱动 — 硬件 TWI0 (nrf_drv_twi)
 *
 * 硬件: RAK4630, SSD1306 @ 0x3C (7-bit I2C)
 *       P0.29 (SDA) / P0.30 (SCL) → NRF_TWIM0
 *
 * I2C 底层: nrf_drv_twi (TWI0, 400kHz), 不依赖 hal_i2c (未被链接)
 * 显示函数: 直接写 GDDRAM, 无帧缓冲
 */
#include <Arduino.h>
#include "nrf_drv_twi.h"
#include "oled_drv.h"
#include "../boards/badge/board.h"

extern "C" int SEGGER_RTT_printf(unsigned, const char*, ...);

#define SSD1306_ADDR  0x3C   /* 7-bit I2C address */

/* ── 硬件 I2C (TWI0, P0.29/P0.30, 400kHz) ── */
static const nrf_drv_twi_t m_twi = NRF_DRV_TWI_INSTANCE(0);
static volatile bool twi_xfer_done;

static void twi_event_handler(nrf_drv_twi_evt_t const *p_event, void *p_context) {
	(void)p_context;
	if (p_event->type == NRF_DRV_TWI_EVT_DONE)
		twi_xfer_done = true;
}

static int i2c_hw_init(void) {
	nrf_drv_twi_config_t twi_cfg = {
		.scl                = OLED_SCL_PIN,       /* P0_30 */
		.sda                = OLED_SDA_PIN,       /* P0_29 */
		.frequency          = NRF_DRV_TWI_FREQ_100K,
		.interrupt_priority = 6,                  /* 应用级, 低于 SoftDevice */
		.clear_bus_init     = false,
		.hold_bus_uninit    = false,
	};

	uint32_t ret = nrf_drv_twi_init(&m_twi, &twi_cfg, twi_event_handler, NULL);
	if (ret != NRF_SUCCESS) {
		SEGGER_RTT_printf(0, "[OLED] I2C init FAIL: %lu\n", ret);
		return -1;
	}
	nrf_drv_twi_enable(&m_twi);

	SEGGER_RTT_printf(0, "[OLED] HW TWI0 SDA=P0.%d SCL=P0.%d addr=0x%02X 100kHz\n",
		OLED_SDA_PIN, OLED_SCL_PIN, SSD1306_ADDR);
	return 0;
}

/* ── 写 SSD1306 ── */
static void oled_write(uint8_t dat, int is_data) {
	uint8_t buf[2] = { is_data ? (uint8_t)0x40 : (uint8_t)0x00, dat };
	twi_xfer_done = false;
	uint32_t ret = nrf_drv_twi_tx(&m_twi, SSD1306_ADDR, buf, 2, false);
	if (ret == NRF_SUCCESS) {
		while (!twi_xfer_done);
	}
}
#define oled_write_cmd(cmd)  oled_write(cmd, 0)
#define oled_write_data(dat) oled_write(dat, 1)

/* ══════════════════════════════════════════════════════════
 * 8x16 ASCII 字库
 * ══════════════════════════════════════════════════════════ */
static const uint8_t font8x16[][16] = {
	{0x00,0x00,0x00,0x00,0x00,0x00,0x00,0x00,0x00,0x00,0x00,0x00,0x00,0x00,0x00,0x00}, /*  32 */
	{0x00,0x00,0x00,0xF8,0x00,0x00,0x00,0x00,0x00,0x00,0x00,0x33,0x30,0x00,0x00,0x00}, /*! 33 */
	{0x00,0x10,0x0C,0x06,0x10,0x0C,0x06,0x00,0x00,0x00,0x00,0x00,0x00,0x00,0x00,0x00}, /*" 34 */
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	{0x00,0x06,0x01,0x01,0x02,0x02,0x04,0x04,0x00,0x00,0x00,0x00,0x00,0x00,0x00,0x00}, /*~ 126 */
};
#define FONT_MAX (sizeof(font8x16) / 16)

/* ══════════════════════════════════════════════════════════
 * OLED 初始化 — SSD1306 命令序列
 * ══════════════════════════════════════════════════════════ */
int oled_init(void) {
	if (i2c_hw_init() != 0) return -1;

	delay(200);
	oled_write_cmd(0xAE); /* display off */
	oled_write_cmd(0x00); /* set low column */
	oled_write_cmd(0x10); /* set high column */
	oled_write_cmd(0x40); /* set start line */
	oled_write_cmd(0xB0); /* set page address */
	oled_write_cmd(0x81); /* contrast control */
	oled_write_cmd(0xFF); /* 255 */
	oled_write_cmd(0xA1); /* segment remap */
	oled_write_cmd(0xA6); /* normal display */
	oled_write_cmd(0xA8); /* multiplex ratio */
	oled_write_cmd(0x3F); /* 1/64 duty */
	oled_write_cmd(0xC8); /* COM scan direction */
	oled_write_cmd(0xD3); /* display offset */
	oled_write_cmd(0x00);
	oled_write_cmd(0xD5); /* osc division */
	oled_write_cmd(0x80);
	oled_write_cmd(0xD8); /* area color mode off */
	oled_write_cmd(0x05);
	oled_write_cmd(0xD9); /* pre-charge period */
	oled_write_cmd(0xF1);
	oled_write_cmd(0xDA); /* COM pin config */
	oled_write_cmd(0x12);
	oled_write_cmd(0xDB); /* Vcomh */
	oled_write_cmd(0x30);
	oled_write_cmd(0x8D); /* charge pump enable */
	oled_write_cmd(0x14);
	oled_write_cmd(0xAF); /* display on */

	SEGGER_RTT_printf(0, "[OLED] Init done (HW TWI0, SSD1306 128x64)\n");
	return 0;
}

/* 设置 GDDRAM 指针 */
static void oled_set_pos(uint8_t x, uint8_t page) {
	oled_write_cmd(0xB0 + page);
	oled_write_cmd(((x & 0xF0) >> 4) | 0x10);
	oled_write_cmd(x & 0x0F);
}

/* 清屏 */
void oled_clear(void) {
	uint8_t page, col;
	for (page = 0; page < 8; page++) {
		oled_write_cmd(0xB0 + page);
		oled_write_cmd(0x00);
		oled_write_cmd(0x10);
		for (col = 0; col < 128; col++)
			oled_write_data(0x00);
	}
}

/* 全屏填充 */
void oled_fill_screen(uint8_t pattern) {
	uint8_t page, col;
	for (page = 0; page < 8; page++) {
		oled_write_cmd(0xB0 + page);
		oled_write_cmd(0x00);
		oled_write_cmd(0x10);
		for (col = 0; col < 128; col++)
			oled_write_data(pattern);
	}
}

/* 在指定 page 显示一个 16px 字符 */
static void oled_show_char(uint8_t x, uint8_t page, uint8_t chr) {
	uint8_t c = chr - ' ';
	if (c >= FONT_MAX) c = 0;

	oled_set_pos(x, page);
	for (uint8_t i = 0; i < 8; i++)
		oled_write_data(font8x16[c][i]);

	oled_set_pos(x, page + 1);
	for (uint8_t i = 0; i < 8; i++)
		oled_write_data(font8x16[c][i + 8]);
}

/* 字符串显示 */
void oled_draw_string(int x, int page, const char *str) {
	while (*str) {
		oled_show_char((uint8_t)x, (uint8_t)page, (uint8_t)*str);
		x += 8;
		if (x > 120) { x = 0; page += 2; }
		str++;
	}
}

void oled_display_on(void)  { oled_write_cmd(0xAF); }
void oled_display_off(void) { oled_write_cmd(0xAE); }

/* 清空指定 page 起的 2 行 */
void oled_clear_line(uint8_t page) {
	uint8_t col;
	for (uint8_t p = page; p < page + 2 && p < 8; p++) {
		oled_write_cmd(0xB0 + p);
		oled_write_cmd(0x00);
		oled_write_cmd(0x10);
		for (col = 0; col < 128; col++)
			oled_write_data(0x00);
	}
}
